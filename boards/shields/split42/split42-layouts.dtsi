#include <physical_layouts.dtsi>

// The tester might not have any physical keys at all, so these
// physical layouts are pretty much imaginary.

/ {
    split42_position_map {
        compatible = "zmk,physical-layout-position-map";
        complete;

        pinout_map: pinout_positions {
            physical-layout = <&physical_layout0>;
            positions
		= <0  1  2  3  4  5     21 22 23 24 25 26>
		, <6  7  8  9  10 11    27 28 29 30 31 32>
		, <12 13 14 15 16 17    33 34 35 36 37 38>
		, <         18 19 20    39 40 41         >;
        };
    };

    physical_layout0: physical_layout_0 {
        compatible = "zmk,physical-layout";
        display-name = "Default Layout";
    };
};
